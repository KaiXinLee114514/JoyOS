/* ============================================================================
 *  JoyOS C 程序的链接脚本
 *
 *  一句话:把程序摆到 0x120000(内核就是从这儿 call 进来的),输出**平铺二进制**
 *  (裸机没人给你解析 ELF)。
 *
 *  为什么要 .bss 的起止符号:平铺二进制里"全是 0 的段"根本不会被写进文件
 *  (省地方),可那段内存在程序跑起来时是**上一次留下的垃圾**。
 *  所以 crt0 得知道 BSS 从哪到哪,进去之前先清零。
 * ==========================================================================*/
OUTPUT_FORMAT(binary)
ENTRY(_start)
SECTIONS
{
    . = 0x120000;

    .text : { *(.text) *(.text.*) }
    .rodata : { *(.rodata) *(.rodata.*) }

    .data : { *(.data) *(.data.*) }

    __bss_start = .;
    .bss : { *(.bss) *(.bss.*) *(COMMON) }
    __bss_end = .;

    /DISCARD/ : { *(.comment) *(.note*) *(.eh_frame*) }
}
